## Kconfig
```kconfig
mainmenu "mrX"

# ==================================
# RSOURCE
# ==================================
rsource "include/mrX/*/Kconfig"
```

## arch/st/stm32/include/platform/Kconfig
```kconfig
menu "Platform: STM32"

# ==================================
# PLATFORM
# ==================================
config MR_USE_PLATFORM
    def_bool y

config MR_USE_STM32
    def_bool y

config MR_CFG_STM32_HAL_HEADER
    string "STM32 HAL umbrella header"
    default "stm32xxxx_hal.h"
    help
        HAL umbrella header provided by the board/Cube project. For example:
        stm32f4xx_hal.h, stm32g4xx_hal.h or stm32h5xx_hal.h. The default is a
        placeholder and must be replaced by the board configuration.

# ==================================
# CACHE
# ==================================
config MR_USE_DCACHE
    bool "Use data cache port"
    default n
    help
        Enable the generic STM32 D-cache port. The backend selects either a
        STM32 HAL DCACHE peripheral or a CMSIS SCB D-cache from the capabilities
        provided by the selected device/HAL headers. The HAL DCACHE instance is
        initialized lazily by the cache port. Board code should use this port
        instead of managing the same cache through a parallel HAL handle.

config MR_USE_ICACHE
    bool "Use instruction cache port"
    default n
    help
        Enable the generic STM32 I-cache port. The backend selects either a
        STM32 HAL ICACHE peripheral or a CMSIS SCB I-cache from the capabilities
        provided by the selected device/HAL headers.

# ==================================
# CLOCK
# ==================================
config MR_CFG_STM32_CLOCK_IRQ_PRIORITY
    int "Clock irq priority"
    default 15
    range 0 15
    help
        NVIC priority for the SysTick interrupt (0=highest, 15=lowest).
        The default matches the common CubeMX setting and keeps the system
        tick below application interrupts. Boards without DWT CYCCNT support
        must disable MR_USE_CLOCK_HIRES.

# ==================================
# TRACE (RTT)
# ==================================
config MR_CFG_STM32_XTRACE_RTT_UP_SIZE
    int "XTrace RTT up buffer size (bytes)"
    depends on MR_USE_MODULE_XTRACE
    default 1024
    range 64 16384
    help
        Target-to-host SEGGER RTT ring buffer size in bytes for XTrace.
        Compatible with J-Link, ST-Link and CMSIS-DAP (via OpenOCD, probe-rs
        or pyOCD). Background draining attaches one clock hook slot.

config MR_CFG_STM32_XTRACE_RTT_DOWN_SIZE
    int "XTrace RTT down buffer size (bytes)"
    depends on MR_USE_MODULE_XTRACE
    default 32
    range 16 1024
    help
        Host-to-target SEGGER RTT ring buffer size in bytes for XTrace
        control commands (e.g. SEGGER SystemView start/stop handshake).

endmenu
```

## arch/st/stm32h5/include/platform/Kconfig
```kconfig
menu "Platform: STM32H5"

# ==================================
# PLATFORM
# ==================================
config MR_USE_PLATFORM
    def_bool y

config MR_USE_STM32H5
    def_bool y

# ==================================
# CACHE
# ==================================
config MR_USE_DCACHE
    bool "Use data cache port"
    default y
    help
        Enable the STM32H5 DCACHE port. The STM32Cube HAL DCACHE module and
        DCACHE peripheral initialization must be enabled by the application.

config MR_USE_ICACHE
    bool "Use instruction cache port"
    default y
    help
        Enable the STM32H5 ICACHE port. The STM32Cube HAL ICACHE module must
        be enabled by the application.

# ==================================
# CLOCK
# ==================================
config MR_CFG_STM32H5_CLOCK_IRQ_PRIORITY
    int "Clock irq priority"
    default 15
    range 0 15
    help
        NVIC priority for the SysTick interrupt (0=highest, 15=lowest).
        The default matches the priority generated by CubeMX and keeps the
        system tick below application interrupts.

endmenu
```

## arch/wch/32v/include/mrX/platform/Kconfig
```kconfig
menu "Platform options"

# ==================================
# PLATFORM
# ==================================
config MR_USE_PLATFORM
    def_bool y

# ==================================
# SERIES
# ==================================
choice
    prompt "Series"
    default MR_USE_WCH_SERIES_XXX

    config MR_USE_WCH_SERIES_XXX
        bool "XXX"

    config MR_USE_WCH_SERIES_V00X
        bool "V00X"

    config MR_USE_WCH_SERIES_V10X
        bool "V10X"

    config MR_USE_WCH_SERIES_V20X
        bool "V20X"

    config MR_USE_WCH_SERIES_V30X
        bool "V30X"
endchoice

# ==================================
# CLOCK
# ==================================
config MR_CFG_WCH_CLOCK_IRQ_PRIORITY
    int "Clock irq priority"
    default 0
    range 0 15

# ==================================
# IRQ-DEFER
# ==================================
config MR_CFG_WCH_DEFER_IRQ_PRIORITY
    depends on MR_USE_IRQ_DEFER
    int "Defer irq priority"
    default 2
    range MR_CFG_WCH_CLOCK_IRQ_PRIORITY 15

config MR_USE_WCH_IRQ_DEFER_HOOK
    depends on MR_USE_IRQ_DEFER
    select MR_USE_IRQ_DEFER_HOOK
    def_bool y

endmenu
```

## arch/wch/ch32/include/platform/Kconfig
```kconfig
menu "Platform: WCH CH32"

# ==================================
# PLATFORM
# ==================================
config MR_USE_PLATFORM
    def_bool y

config MR_USE_CH32
    def_bool y

choice
    prompt "WCH EVT SDK family"
    default MR_USE_CH32V00X

config MR_USE_CH32V00X
    bool "CH32V003 (CH32V00x SDK)"

config MR_USE_CH32VM00X
    bool "CH32V002/004/005/006/007 (CH32VM00X SDK)"

config MR_USE_CH32V10X
    bool "CH32V103 (CH32V10x SDK)"

config MR_USE_CH32V20X
    bool "CH32V20x"

config MR_USE_CH32V205
    bool "CH32V205/V203CCT6 (CH32V205 SDK)"

config MR_USE_CH32V30X
    bool "CH32V30x"

config MR_USE_CH32V4X7
    bool "CH32V407/V467 (CH32V4x7 SDK)"

endchoice

# ==================================
# CACHE
# ==================================
config MR_USE_ICACHE
    bool "Use instruction fetch synchronization port"
    default n
    help
        Provide the mr_port_icache invalidation APIs through fence.i on
        the local hart. The supported CH32 families have no software-
        controlled instruction cache. Enable and disable return -MR_ENOSYS,
        and the line size is zero.

# ==================================
# DEBUG
# ==================================
config MR_USE_CH32_DEBUG_OUTPUT
    bool "Use WCH EVT debug output"
    default y
    help
        Forward mrX diagnostic output to the _write function from the
        WCH EVT Debug/debug.c. Initialize the selected debug transport
        before calling mr_user_init. Disable this option if the board
        supplies its own diagnostic output hook.

endmenu
```

## arch/wch/ch32v/include/platform/Kconfig
```kconfig
menu "Platform: Platform abstraction"

# ==================================
# PLATFORM
# ==================================
config MR_USE_PLATFORM
    def_bool y

# ==================================
# SERIES
# ==================================
choice
    prompt "Series"
    default MR_USE_WCH_SERIES_XXX

    config MR_USE_WCH_SERIES_XXX
        bool "XXX"

    config MR_USE_WCH_SERIES_V00X
        bool "V00X"

    config MR_USE_WCH_SERIES_V10X
        bool "V10X"

    config MR_USE_WCH_SERIES_V20X
        bool "V20X"

    config MR_USE_WCH_SERIES_V30X
        bool "V30X"
endchoice

# ==================================
# CLOCK
# ==================================
config MR_CFG_WCH_CLOCK_IRQ_PRIORITY
    int "Clock irq priority"
    default 0
    range 0 15
    help
        NVIC priority for system tick interrupt (0=highest, 15=lowest).
        Lower value = higher priority. Should be the highest priority
        interrupt to ensure accurate timekeeping.

# ==================================
# IRQ-DEFER
# ==================================
config MR_CFG_WCH_DEFER_IRQ_PRIORITY
    depends on MR_USE_IRQ_DEFER
    int "Defer irq priority"
    default 2
    range MR_CFG_WCH_CLOCK_IRQ_PRIORITY 15
    help
        NVIC priority for deferred IRQ workqueue interrupt.
        Must be lower priority (higher number) than clock IRQ.
        Adjust based on your system's real-time requirements.

config MR_USE_WCH_IRQ_DEFER_HOOK
    depends on MR_USE_IRQ_DEFER
    select MR_USE_IRQ_DEFER_HOOK
    def_bool y
    help
        Enable WCH-specific defer IRQ hooks for lifecycle monitoring.
        Provides visibility into when deferred interrupt processing
        becomes active or idle.

endmenu
```

## arch/wch/riscv/include/mrX/platform/Kconfig
```kconfig
menu "Platform options"

# ==================================
# PLATFORM
# ==================================
config MR_USE_PLATFORM
    def_bool y

# ==================================
# CLOCK
# ==================================
config MR_CFG_WCH_CLOCK_IRQ_PRIORITY
    int "Clock irq priority"
    default 0
    range 0 15
    help
        NVIC priority for system tick interrupt (0=highest, 15=lowest).
        Lower value = higher priority. Should be the highest priority
        interrupt to ensure accurate timekeeping.

# ==================================
# IRQ-DEFER
# ==================================
config MR_CFG_WCH_DEFER_IRQ_PRIORITY
    depends on MR_USE_IRQ_DEFER
    int "Defer irq priority"
    default 2
    range MR_CFG_WCH_CLOCK_IRQ_PRIORITY 15
    help
        NVIC priority for deferred IRQ workqueue interrupt.
        Must be lower priority (higher number) than clock IRQ.
        Adjust based on your system's real-time requirements.

config MR_USE_WCH_IRQ_DEFER_HOOK
    depends on MR_USE_IRQ_DEFER
    select MR_USE_IRQ_DEFER_HOOK
    def_bool y
    help
        Enable WCH-specific defer IRQ hooks for lifecycle monitoring.
        Provides visibility into when deferred interrupt processing
        becomes active or idle.

endmenu
```

## arch/wch/riscv/v00x/include/mrX/platform/Kconfig
```kconfig
# ==================================
# SERIES
# ==================================
config MR_USE_WCH_SERIES_V00X
    def_bool y
```

## arch/wch/riscv/v10x/include/mrX/platform/Kconfig
```kconfig
# ==================================
# SERIES
# ==================================
config MR_USE_WCH_SERIES_V10X
    def_bool y
```

## arch/wch/riscv/v20x/include/mrX/platform/Kconfig
```kconfig
# ==================================
# SERIES
# ==================================
config MR_USE_WCH_SERIES_V20X
    def_bool y
```

## arch/wch/riscv/v30x/include/mrX/platform/Kconfig
```kconfig
# ==================================
# SERIES
# ==================================
config MR_USE_WCH_SERIES_V30X
    def_bool y
```

## arch/win/include/platform/Kconfig
```kconfig
menu "Platform: Windows"

# ==================================
# PLATFORM
# ==================================
config MR_USE_PLATFORM
    def_bool y

config MR_USE_WIN
    def_bool y

# ==================================
# IRQ-DEFER
# ==================================
config MR_USE_WIN_IRQ_DEFER_HOOK
    depends on MR_USE_IRQ_DEFER
    select MR_USE_IRQ_DEFER_HOOK
    def_bool y
    help
        Wake a host thread to run deferred IRQ work.
        wakeup releases a semaphore; the thread calls mr_irq_defer_execute.

# ==================================
# UART
# ==================================
config MR_USE_WIN_UART_TCP
    bool "Use Windows TCP server backend for UART"
    depends on MR_USE_DRIVER_UART
    default y
    help
        Enable Winsock2 TCP listener support for Windows UART simulation.
        Host-side RPC and trace tools can connect directly to the configured
        TCP port. Requires linking ws2_32 (-lws2_32 on MinGW, ws2_32.lib on
        MSVC).

config MR_CFG_WIN_UART_RX_BUF_SIZE
    int "Windows UART RX ring buffer size (bytes)"
    depends on MR_USE_DRIVER_UART
    default 4096
    range 64 65536
    help
        Internal RX ring buffer size in bytes for each Windows UART instance.

endmenu
```

## arch/x86/win/include/mrX/platform/Kconfig
```kconfig
menu "Platform options"

# ==================================
# PLATFORM
# ==================================
config MR_USE_PLATFORM
    select MR_USE_ARCH_64B
    def_bool y

endmenu
```

## bsp/wch/common/include/board/Kconfig
```kconfig
menu "Board options"

# ==================================
# BOARD
# ==================================
config MR_USE_BOARD
    def_bool y

# ==================================
# SERIES
# ==================================
choice
    prompt "Series"
    default MR_USE_SERIES_V30X

    config MR_USE_SERIES_V00X
        bool "V00X"

    config MR_USE_SERIES_V10X
        bool "V10X"

    config MR_USE_SERIES_V20X
        bool "V20X"

    config MR_USE_SERIES_V30X
        bool "V30X"
endchoice

# ==================================
# SYSTICK
# ==================================
config MR_CFG_WCH_SYSTICK_IRQ_PRIORITY
    int "Systick irq priority"
    default 1
    range 0 15

# ==================================
# NVIC
# ==================================
config MR_CFG_WCH_IRQ_DEFER_PRIORITY
    int "Defer irq priority"
    default 2
    range MR_CFG_WCH_SYSTICK_IRQ_PRIORITY 15

config MR_USE_WCH_IRQ_DEFER_HOOK
    select MR_USE_IRQ_DEFER_HOOK
    def_bool y

endmenu
```

## bsp/x86_64_win/example/mr-library/source/task/Kconfig
```kconfig
menu "Task options"
    # NAME
    config MR_CFG_TASK_NAME_MAX
        int "task name max length"
        default 8
        range 4 64
        help
            This option sets the maximum length of the task name.
    # PRIORITY
    config MR_CFG_TASK_PRIORITY_MAX
        int "task priority max"
        default 32
        range 1 32
        help
            This option sets the maximum number of task priorities.
    # STACK-OVERFLOW
    config MR_USE_TASK_STACK_OVERFLOW_CHECK
        bool "use task stack overflow check"
        default y
        help
            This option allows you to use the task stack overflow check.
    # IDLE-STACK-SIZE
    comment "IDLE-TASK"
    config MR_CFG_TASK_IDLE_STACK_SIZE
        int "idle task stack size"
        default 512
        range 64 2147483647
        help
            This option sets the stack size of the idle task.
    # MAIN-PRIORITY
    comment "MAIN-TASK"
    config MR_CFG_TASK_MAIN_PRIORITY
        int "main task priority"
        default 15
        range 0 31
        help
            This option sets the priority of the main task(must < (max - 1)).
    # MAIN-STACK-SIZE
    config MR_CFG_TASK_MAIN_STACK_SIZE
        int "main task stack size"
        default 1024
        range 64 2147483647
        help
            This option sets the stack size of the main task.
endmenu
```

## include/drivers/Kconfig
```kconfig
menu "Drivers options"

# ==================================
# DRIVER
# ==================================
config MR_USE_DRIVER
    bool "Use driver"
    default n

config MR_USE_DRIVER_IRQ
    select MR_USE_WAIT
    bool "Use driver irq"
    default n

# ==================================
# RSOURCE
# ==================================
rsource "*/Kconfig"

endmenu
```

## include/drivers/gpio/Kconfig
```kconfig
menu "GPIO options"

# ==================================
# GPIO
# ==================================
config MR_USE_DRIVER_GPIO
    select MR_USE_DRIVER
    bool "Use GPIO"
    default n

# ==================================
# IRQ
# ==================================
config MR_USE_DRIVER_GPIO_IRQ
    select MR_USE_DRIVER_IRQ
    bool "Use GPIO irq"
    default n

endmenu
```
