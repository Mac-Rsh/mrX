## include/kernel/Kconfig
```kconfig
menu "Kernel options"
    # ENTRY
    config MR_USE_ENTRY
        bool "Use entry"
        default n
        help
            This option controls whether to use entry.
    # KCLOCK
    config MR_CFG_KCLOCK_HOOK_SIZE
        int "Kclock hook size"
        default 4
        range 2 32
        help
            This option controls the size of the clock hook.
    # KOBJECT
    config MR_CFG_KOBJECT_INAME_SIZE
        int "Kobject inline name size"
        default 8
        range 4 256
        help
            This option controls the size of the inline name of the kobject.
    # KPRINTF
    config MR_USE_KPRINTF
        bool "Use kprintf"
        default y
        help
            This option controls whether to use kprintf.
    config MR_CFG_KPRINTF_BUF_SIZE
        depends on MR_USE_KPRINTF
        int "Kprintf buffer size"
        default 64
        range 8 65535
        help
            This option controls the buffer size of the kprintf.
    config MR_USE_KPRINTF_SAFE
        depends on MR_USE_KPRINTF
        bool "Use kprintf safe"
        default n
        help
            This option controls whether to use kprintf safe.
    # KTIMER
    config MR_USE_KTIMER
        bool "Use ktimer"
        default y
        help
            This option controls whether to use ktimer.
    config MR_USE_KTIMER_ATTR
        bool "Use ktimer attribute"
        default n
        help
            This option controls whether to use ktimer attribute.
    # KWORKQUEUE
    config MR_USE_KWORKQUEUE
        depends on MR_USE_KTIMER
        bool "Use kworkqueue"
        default y
        help
            This option controls whether to use kworkqueue.
    config MR_USE_KWORKQUEUE_HOOK
        depends on MR_USE_KWORKQUEUE
        bool "Use kworkqueue hook"
        default n
        help
            This option controls whether to use kworkqueue hook.
    # IRQ
    config MR_USE_IRQ
        bool "Use irq"
        default y
        help
            This option controls whether to use irq.
    config MR_CFG_IRQ_TABLE_SIZE
        depends on MR_USE_IRQ
        int "Irq table size"
        default 32
        range 4 512
        help
            This option controls the size of the irq table.
endmenu
```

## include/kernel/os/Kconfig
```kconfig
menu "OS options"
    # KOS
    config MR_USE_KOS
        bool "Use kernel os"
        default n
        help
            This option controls whether to use kernel os.
    # KTHREAD
    config MR_CFG_KTHREAD_ITHREAD_SIZE
        depends on MR_USE_KOS
        int "Kthread inline thread size"
        default 256
        range 4 1024
        help
            This option controls the size of the inline thread of the kthread.
    # KMUTEX
    config MR_USE_KMUTEX
        depends on MR_USE_KOS
        bool "Use kernel mutex"
        default n
        help
            This option controls whether to use kernel mutex.
    config MR_CFG_KTHREAD_ITHREAD_SIZE
        depends on MR_USE_KMUTEX
        int "Kmutex inline mutex size"
        default 64
        range 4 1024
        help
            This option controls the size of the inline mutex of the kmutex.
endmenu
```

## include/libc/Kconfig
```kconfig
menu "Libc options"

# ==================================
# ARCH
# ==================================
choice
    prompt "Arch"
    default MR_USE_ARCH_32BIT

    config MR_USE_ARCH_32BIT
        bool "32B"

    config MR_USE_ARCH_64BIT
        bool "64B"
endchoice

# ==================================
# MALLOC
# ==================================
choice
    prompt "Malloc"
    default MR_USE_MALLOC

    config MR_USE_MALLOC_LIBC
        bool "STD"

    config MR_USE_MALLOC_3PARTY
        bool "3RD"

    config MR_USE_MALLOC
        bool "INT"
endchoice

config MR_CFG_HEAP_SIZE
    depends on !MR_USE_MALLOC_LIBC
        int "Heap memory size(Bytes)"
        default 4096
        range 24 2147483647

# ==================================
# SPRINTF
# ==================================
choice
    prompt "Sprintf"
    default MR_USE_SPRINTF

    config MR_USE_SPRINTF_LIBC
        bool "STD"

    config MR_USE_SPRINTF_3PARTY
        bool "3RD"

    config MR_USE_SPRINTF
        bool "INT"
endchoice

# ==================================
# ASSERT
# ==================================
choice
    prompt "Assertion"
    default MR_USE_ASSERT

    config MR_USE_ASSERT_LIBC
        bool "STD"

    config MR_USE_ASSERT_3PARTY
        bool "3RD"

    config MR_USE_ASSERT
        bool "INT"
endchoice

# ==================================
# STRING
# ==================================
choice
    prompt "String"
    default MR_USE_STRING

    config MR_USE_STRING_LIBC
        bool "STD"

    config MR_USE_STRING_3PARTY
        bool "3RD"

    config MR_USE_STRING
        bool "INT"
endchoice

config MR_USE_STRING_SAFE
    depends on MR_USE_STRING
        bool "Use string null-ptr safety"
        default y

# ==================================
# SSCANF
# ==================================
choice
    prompt "Sscanf"
    default MR_USE_SSCANF

    config MR_USE_SSCANF_LIBC
        bool "STD"

    config MR_USE_SSCANF_3PARTY
        bool "3RD"

    config MR_USE_SSCANF
        bool "INT"
endchoice

# ==================================
# TYPES
# ==================================
choice
    prompt "Types"
    default MR_USE_TYPES

    config MR_USE_TYPES_LIBC
        bool "STD"

    config MR_USE_TYPES
        bool "INT"
endchoice

# ==================================
# ERRNO
# ==================================
choice
    prompt "Errno"
    default MR_USE_ERRNO

    config MR_USE_ERRNO_LIBC
        bool "STD"

    config MR_USE_ERRNO_3PARTY
        bool "3RD"

    config MR_USE_ERRNO
        bool "INT"
endchoice

endmenu
```

## include/mr-X/Kconfig
```kconfig
menu "Kernel options"

# ==================================
# ENTRY
# ==================================
config MR_USE_ENTRY
    bool "Use entry"
    default n

# ==================================
# CLOCK
# ==================================
config MR_CFG_CLOCK_HOOK_SIZE
    int "Clock hook size"
    default 2
    range 2 128

config MR_CFG_TICK_PER_SECOND
    int "Tick per-second"
    default 1000
    range 1 2147483647

# ==================================
# PRINTF
# ==================================
config MR_USE_PRINTF
    bool "Use printf"
    default n

config MR_CFG_PRINTF_BUF_SIZE
    depends on MR_USE_PRINTF
    int "Printf buffer size"
    default 64
    range 8 65535

config MR_USE_PRINTF_SAFE
    depends on MR_USE_PRINTF
    bool "Use printf safe"
    default n

# ==================================
# TIMER
# ==================================
config MR_USE_TIMER
    bool "Use timer"
    default y

# ==================================
# WORKQUEUE
# ==================================
config MR_USE_WORKQUEUE
    select MR_USE_TIMER
    bool "Use workqueue"
    default y

config MR_USE_WORKQUEUE_HOOK
    depends on MR_USE_WORKQUEUE
    bool "Use workqueue hook"
    default n

# ==================================
# IRQ
# ==================================
config MR_USE_IRQ
    bool "Use irq"
    default y

config MR_CFG_IRQ_TABLE_SIZE
    depends on MR_USE_IRQ
    int "Irq table size"
    default 32
    range 4 1024

config MR_USE_IRQ_DEFER
    depends on MR_USE_IRQ
    select MR_USE_WORKQUEUE
    bool "Use irq defer"
    default y

config MR_USE_IRQ_DEFER_HOOK
    depends on MR_USE_IRQ_DEFER
    select MR_USE_WORKQUEUE_HOOK
    bool "Use irq defer hook"
    default n

# ==================================
# ASYNC
# ==================================
config MR_USE_ASYNC
    select MR_USE_WORKQUEUE
    bool "Use async"
    default y

config MR_USE_ASYNC_SYNC
    depends on MR_USE_ASYNC
    bool "Use async sync"
    default n

endmenu
```

## include/mr-X/test/Kconfig
```kconfig
menu "Test options"

# ==================================
# TEST
# ==================================
config MR_USE_TEST
    select MR_USE_PRINTF
    bool "Use test"
    default n

endmenu
```

## include/mrX/drivers/Kconfig
```kconfig
menu "Drivers: Hardware abstraction"

# ==================================
# DRIVER
# ==================================
config MR_USE_DRIVER
    select MR_USE_WAIT
    bool "Use driver"
    default n
    help
        Enable unified driver framework providing device registration,
        reference counting, and lifecycle management.
        Required by all peripheral drivers.

config MR_USE_DRIVER_TRACE
    depends on MR_USE_DRIVER
    depends on MR_USE_TRACE
    bool "Use driver trace"
    default n
    help
        Enable trace events for driver setup, shutdown, and release lifecycle
        operations.

# ==================================
# RSOURCE
# ==================================
rsource "*/Kconfig"

endmenu
```
