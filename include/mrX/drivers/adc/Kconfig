## include/mrX/drivers/adc/Kconfig
```kconfig
menu "ADC: Analog-to-Digital Converter"

# ==================================
# ADC
# ==================================
config MR_USE_DRIVER_ADC
    depends on MR_USE_DRIVER
    bool "Use ADC"
    default n
    help
        Enable ADC driver for analog-to-digital conversion.
        Features:
            - Single-ended and differential input modes
            - Programmable gain amplifier (1/6x to 128x)
            - Configurable reference voltage (internal/external)
            - Hardware oversampling support
            - Raw to voltage conversion utilities (mV/uV/V)
            - Multi-channel sequential sampling

# ==================================
# STREAM
# ==================================
config MR_USE_DRIVER_ADC_STREAM
    depends on MR_USE_DRIVER_ADC
    bool "Use ADC stream"
    default y
    help
        Enable ADC stream sampling operations.
        Features:
            - DMA-based continuous sampling for high-speed data streams
            - Interrupt-driven continuous sampling without DMA
            - Half/full buffer completion wait events
            - Circular buffer mode for ping-pong sampling
        Required for continuous sampling and stream buffer events.

endmenu
```

## include/mrX/drivers/dac/Kconfig
```kconfig
menu "DAC: Digital-to-Analog Converter"

# ==================================
# DAC
# ==================================
config MR_USE_DRIVER_DAC
    depends on MR_USE_DRIVER
    bool "Use DAC"
    default n
    help
        Enable DAC driver for digital-to-analog conversion.
        Features:
            - Single-value write per channel
            - Configurable reference voltage (internal/external)
            - Voltage to raw conversion utilities (mV/uV/V)
            - Multi-channel output

# ==================================
# STREAM
# ==================================
config MR_USE_DRIVER_DAC_STREAM
    depends on MR_USE_DRIVER_DAC
    bool "Use DAC stream"
    default y
    help
        Enable DAC stream output operations.
        Features:
            - DMA-based continuous output for waveform generation
            - Interrupt-driven continuous output without DMA
            - Half/full buffer completion wait events
            - Circular buffer mode for ping-pong output
        Required for continuous output and stream buffer events.

endmenu
```

## include/mrX/drivers/dma/Kconfig
```kconfig
menu "DMA: Direct Memory Access"

# ==================================
# DMA
# ==================================
config MR_USE_DRIVER_DMA
    depends on MR_USE_DRIVER
    bool "Use DMA"
    default n
    help
        Enable the DMA controller and channel driver framework.
        Platform backends provide hardware-specific transfer operations.

endmenu
```

## include/mrX/drivers/eth/Kconfig
```kconfig
menu "ETH: Ethernet"

# ==================================
# ETH
# ==================================
config MR_USE_DRIVER_ETH
    depends on MR_USE_DRIVER
    bool "Use Ethernet"
    default n
    help
        Enable the Ethernet driver framework.
        Provides frame receive and transmit, link status and port configuration.

config MR_USE_DRIVER_ETH_STREAM
    depends on MR_USE_DRIVER_ETH
    bool "Use Ethernet stream"
    default y
    help
        Enable independent receive and transmit streams with per-frame
        submission. The backend returns accepted frames via Wait notifications.

endmenu
```

## include/mrX/drivers/flash/Kconfig
```kconfig
menu "FLASH: Flash memory"

# ==================================
# FLASH
# ==================================
config MR_USE_DRIVER_FLASH
    depends on MR_USE_DRIVER
    bool "Use flash memory"
    default n
    help
        Enable the flash memory driver framework.
        Platform backends provide internal or external flash operations.

endmenu
```

## include/mrX/drivers/gpio/Kconfig
```kconfig
menu "GPIO: General Purpose Input/Output"

# ==================================
# GPIO
# ==================================
config MR_USE_DRIVER_GPIO
    depends on MR_USE_DRIVER
    bool "Use GPIO"
    default n
    help
        Enable GPIO driver for general purpose digital I/O pins.
        Features:
            - Configurable input/output modes
            - Pull-up/pull-down resistor control
            - Triggered interrupt support (rising/falling/both/high/low)
            - Port-based batch operations for efficiency
        Fundamental for controlling LEDs, buttons, switches, and chip selects.
        HardTree backends also support PCF8574/PCF8574A and PCA9555 over I2C,
        and MCP23017/MCP23S17 over I2C/SPI when that bus driver is enabled.

endmenu
```

## include/mrX/drivers/i2c/Kconfig
```kconfig
menu "I2C: Inter-Integrated Circuit"

# ==================================
# I2C
# ==================================
config MR_USE_DRIVER_I2C
    depends on MR_USE_DRIVER
    bool "Use I2C"
    default n
    help
        Enable the I2C bus controller driver framework.
        Features:
            - Master message transfers with repeated START support
            - Slave receive/transmit data paths
            - 7-bit and 10-bit addressing
            - Explicit STOP/NOSTOP message control
            - Waitable interrupt/event notification
        DMA and interrupt transfer details are provided by controller backends.

endmenu
```

## include/mrX/drivers/pwm/Kconfig
```kconfig
menu "PWM: Pulse-Width Modulation"

# ==================================
# PWM
# ==================================
config MR_USE_DRIVER_PWM
    depends on MR_USE_DRIVER
    bool "Use PWM"
    default n
    help
        Enable the pulse-width modulation driver framework.
        Features:
            - Controller timing and per-channel output configuration
            - Atomic multi-channel updates
            - Complementary outputs and dead time
            - Fault inputs and controller-level hardware signals
        The PCA9685 HardTree backend requires I2C and supports continuous,
        edge-aligned PWM with immediate updates, without advanced signals.

endmenu
```

## include/mrX/drivers/ram/Kconfig
```kconfig
menu "RAM: Memory device driver"

# ==================================
# RAM
# ==================================
config MR_USE_DRIVER_RAM
    depends on MR_USE_DRIVER
    bool "Use RAM"
    default n
    help
        Enable RAM driver for memory device abstraction.
        Provides unified interface for both internal and external memory:
            - SRAM, PSRAM, SDRAM, and similar memory devices
            - Memory-mapped access abstraction
            - Block and byte-level operations
            - Device-specific timing configuration
        Useful for external memory expansion and unified memory management.

endmenu
```

## include/mrX/drivers/spi/Kconfig
```kconfig
menu "SPI: Serial Peripheral Interface"

# ==================================
# SPI
# ==================================
config MR_USE_DRIVER_SPI
    depends on MR_USE_DRIVER
    bool "Use SPI"
    default n
    help
        Enable the SPI bus controller driver framework.
        Features:
            - Controller-managed chip-select indexes
            - Per-chip-select bus configurations
            - Segmented synchronous full-duplex transfers
            - Slave frame queues and selectable event notification
        Master, slave, DMA, and interrupt capabilities are implemented by
        controller backends and may return -MR_ENOSYS when unsupported.

# ==================================
# STREAM
# ==================================
config MR_USE_DRIVER_SPI_STREAM
    depends on MR_USE_DRIVER_SPI
    bool "Use SPI stream"
    default y
    help
        Enable asynchronous SPI stream transfer operations.
        Features:
            - One message per stream
            - DMA-based or interrupt-driven transfers
            - Independent TX/RX buffer lengths and circular periods
            - Directional half/full and unified stream error wait events
            - Busy state, stop, and directional byte offset queries
        Message arrays are not supported by this interface.

endmenu
```

## include/mrX/drivers/tmr/Kconfig
```kconfig
menu "TMR: Hardware timer"

# ==================================
# TMR
# ==================================
config MR_USE_DRIVER_TMR
    depends on MR_USE_DRIVER
    bool "Use hardware timer"
    default n
    help
        Enable the basic hardware timer driver framework.
        Platform backends provide hardware-specific timer operations.

endmenu
```

## include/mrX/drivers/uart/Kconfig
```kconfig
menu "UART: Universal Asynchronous Receiver/Transmitter"

# ==================================
# UART
# ==================================
config MR_USE_DRIVER_UART
    depends on MR_USE_DRIVER
    bool "Use UART"
    default n
    help
        Enable UART driver for asynchronous serial communication.
        Features:
            - Configurable baud rate, data bits, stop bits and parity
            - Optional RTS/CTS hardware flow control
            - Direct byte read and write without software FIFO
            - Waitable receive and transmit events

# ==================================
# STREAM
# ==================================
config MR_USE_DRIVER_UART_STREAM
    depends on MR_USE_DRIVER_UART
    bool "Use UART stream"
    default y
    help
        Enable UART stream transfer operations.
        Features:
            - Independent receive and transmit streams
            - DMA-based or interrupt-driven transfers
            - Half/full buffer completion wait events
            - Circular buffer mode for continuous transfers
        Required for asynchronous stream buffer events.

endmenu
```

## include/mrX/drivers/wdt/Kconfig
```kconfig
menu "WDT: Watchdog timer"

# ==================================
# WDT
# ==================================
config MR_USE_DRIVER_WDT
    depends on MR_USE_DRIVER
    bool "Use watchdog timer"
    default n
    help
        Enable the watchdog timer driver framework.
        Platform backends provide hardware-specific watchdog operations.

endmenu
```

## include/mrX/fs/Kconfig
```kconfig
menu "Fs: File system"

# ==================================
# FS
# ==================================
config MR_USE_FS
    bool "Use file system"
    select MR_USE_REF_LONG_COUNT
    default n
    help
        Enable the file system. Provides a path-based structure built
        on a directory-entry(dentry) tree, independent inodes with file
        operations, a handle-based open/read/write API, and a file-system
        mount/unmount framework.

config MR_USE_FS_MULTIUSER
    depends on MR_USE_FS
    bool "Use multi-user"
    default n
    help
        Provide a file-system structure(root/cwd) for each caller instead of
        using one global structure. When enabled, the platform must provide
        mr_fs_struct_current() and return the structure owned by the current task.

config MR_CFG_FS_PATH_LEN
    depends on MR_USE_FS
    int "Path length"
    default 260
    range 32 65535
    help
        Maximum length, in characters, of an absolute path. It is the
        recommended buffer size for mr_fs_getcwd(); passing a buffer smaller
        than the actual working-directory path makes mr_fs_getcwd() return
        -MR_ERANGE.

config MR_CFG_FS_INLINE_NAME_LEN
    depends on MR_USE_FS
    int "Short-name inline buffer"
    default 8
    range 2 256
    help
        Size of the in-object buffer used to store short dentry names. This is
        not the maximum file name length. Names shorter than this size are
        stored in the dentry object; longer names are allocated on the heap.
        Increase this value to reduce heap usage when short names are common.

# ==================================
# RSOURCE
# ==================================
rsource "*/Kconfig"

endmenu
```

## include/mrX/fs/ramfs/Kconfig
```kconfig
menu "RamFs: In-memory file system"

# ==================================
# RAMFS
# ==================================
config MR_USE_FS_RAMFS
    depends on MR_USE_FS
    bool "Use ramfs"
    default n
    help
        Enable the in-memory reference file system(ramfs). It is automatically
        registered at boot and can be mounted by name("ramfs"). Regular files
        are backed by a growable heap buffer. Use it as an example filesystem
        implementation and for testing the FS.

config MR_USE_FS_RAMFS_FIFO
    depends on MR_USE_FS_RAMFS
    bool "Use ramfs FIFO nodes"
    default y
    help
        Enable named FIFO nodes in ramfs. Create them with mr_fs_mkfifo() or
        mr_fs_mknod(path, MR_INODE_FIFO, MR_NULL). First-version FIFOs are
        shared non-blocking byte queues.

config MR_CFG_FS_RAMFS_FIFO_SIZE
    depends on MR_USE_FS_RAMFS_FIFO
    int "Default ramfs FIFO size"
    default 32
    range 1 1048576
    help
        Default byte capacity used when create or mknod allocates a ramfs FIFO.

endmenu
```

## include/mrX/fs/rootfs/Kconfig
```kconfig
menu "RootFS: Namespace-only file system"

# ==================================
# ROOTFS
# ==================================
config MR_USE_FS_ROOTFS
    depends on MR_USE_FS
    bool "Use rootfs"
    default n
    help
        Enable the namespace-only root file system(rootfs). It is automatically
        registered at boot and can be mounted by name("rootfs"). It maintains
        directories and typed nodes without storing regular-file data. Directory
        enumeration is supported, while read, write, and truncate operations are
        not provided.

endmenu
```

## include/mrX/fs/treefs/Kconfig
```kconfig
menu "TreeFS: Namespace-only file system"

# ==================================
# TREEFS
# ==================================
config MR_USE_FS_TREEFS
    depends on MR_USE_FS
    bool "Use treefs"
    default n
    help
        Enable the namespace-only tree file system(treefs). It is automatically
        registered at boot and can be mounted by name("treefs"). It maintains
        directories and typed nodes without storing regular-file data. Directory
        enumeration is supported, while read, write, and truncate operations are
        not provided.

endmenu
```
