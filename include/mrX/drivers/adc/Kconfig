## include/mrX/modules/Kconfig
```kconfig
menu "Modules: Extension modules"

# ==================================
# MODULE
# ==================================
config MR_USE_MODULE
    bool "Use module"
    default y
    help
        Enable the module subsystem. Modules build on top of the kernel and
        provide higher-level services.

# ==================================
# RSOURCE
# ==================================
rsource '*/Kconfig'

endmenu
```

## include/mrX/modules/boot/Kconfig
```kconfig
menu "Boot: A/B boot and update"

# ==================================
# BOOT
# ==================================
config MR_USE_MODULE_BOOT
    depends on MR_USE_MODULE
    bool "Use Boot"
    default n
    help
        Enable A/B firmware selection and streaming update support.

config MR_USE_MODULE_BOOT_SHA256
    depends on MR_USE_MODULE_BOOT
    bool "Use SHA-256 verification"
    default y
    help
        Enable SHA-256 image verification and fast validation support.

config MR_USE_MODULE_BOOT_ECDSA_P256
    depends on MR_USE_MODULE_BOOT
    select MR_USE_MODULE_BOOT_SHA256
    bool "Use ECDSA P-256 verification"
    default y
    help
        Enable ECDSA P-256 manifest signature verification. This also enables
        SHA-256 verification.

config MR_USE_MODULE_BOOT_RECOVERY
    depends on MR_USE_MODULE_BOOT
    bool "Use recovery firmware"
    default n
    help
        Enable a dedicated read-only recovery firmware boot slot. Recovery
        firmware is used when no valid APP is available.

config MR_USE_MODULE_BOOT_AUTH
    depends on MR_USE_MODULE_BOOT
    bool "Use authenticated state"
    default y
    help
        Protect persistent Boot state against tampering with HMAC-SHA256.

config MR_USE_MODULE_BOOT_FAST
    depends on MR_USE_MODULE_BOOT_SHA256
    bool "Use fast validation"
    default n
    help
        Trust a previously fully verified slot when its cached manifest digest
        is unchanged.

config MR_CFG_BOOT_VERIFY_BUFFER_SIZE
    depends on MR_USE_MODULE_BOOT_SHA256
    int "Boot verification buffer size"
    default 256
    range 64 4096
    help
        Scratch buffer used while hashing firmware from storage.

endmenu
```

## include/mrX/modules/crypto/Kconfig
```kconfig
menu "Crypto: Cryptographic algorithms"

# ==================================
# CRYPTO
# ==================================
config MR_USE_MODULE_CRYPTO
    depends on MR_USE_MODULE
    bool "Use crypto"
    default n
    help
        Enable platform-independent software cryptographic algorithms.

# ==================================
# SHA
# ==================================
config MR_USE_MODULE_CRYPTO_SHA256
    depends on MR_USE_MODULE_CRYPTO
    bool "Use SHA-256"
    default n
    help
        Enable SHA-256 hashing.

config MR_USE_MODULE_CRYPTO_HMAC_SHA256
    depends on MR_USE_MODULE_CRYPTO
    select MR_USE_MODULE_CRYPTO_SHA256
    bool "Use HMAC-SHA-256"
    default n
    help
        Enable HMAC authentication based on SHA-256.

# ==================================
# ECC
# ==================================
config MR_USE_MODULE_CRYPTO_P256
    depends on MR_USE_MODULE_CRYPTO
    bool "Use P-256"
    default n
    help
        Enable NIST P-256/secp256r1 elliptic-curve arithmetic.

config MR_USE_MODULE_CRYPTO_ECDSA_P256
    depends on MR_USE_MODULE_CRYPTO
    select MR_USE_MODULE_CRYPTO_P256
    bool "Use P-256 ECDSA"
    default n
    help
        Enable ECDSA signature verification over NIST P-256.

endmenu
```

## include/mrX/modules/rpc/Kconfig
```kconfig
menu "RPC: Remote procedure call"

# ==================================
# RPC
# ==================================
config MR_USE_MODULE_RPC
    depends on MR_USE_MODULE
    select MR_USE_TIMER
    bool "Use RPC"
    default n
    help
        Enable the basic remote procedure call object, IO, and command types.

config MR_USE_MODULE_RPC_HOOK
    depends on MR_USE_MODULE_RPC
    bool "Use RPC hook"
    default n
    help
        Enable callbacks for RPC executor lifecycle events.
        wakeup: Called when an executor transitions from idle to running.
        suspend: Called when an executor transitions from running to idle.
        Execute and subscription poll events are reported independently.
        Useful for custom scheduling, power management, or runtime monitoring.

config MR_USE_MODULE_RPC_SELF_DESC
    depends on MR_USE_MODULE_RPC
    bool "Use RPC self description"
    default n
    help
        Embed the compiled RPC description in ROM and export the generated
        self-description RPC method. Disable this option to remove both the
        description bytes and self-description workspace from the firmware.

config MR_CFG_RPC_SELF_DESC_CHUNK_SIZE
    depends on MR_USE_MODULE_RPC_SELF_DESC
    int "RPC self-description chunk size"
    default 128
    range 16 1024
    help
        Maximum number of description bytes returned by one self-description
        request. Increasing this value reduces round trips but may increase each
        RPC session response workspace when user responses are smaller.

# ==================================
# CALL
# ==================================
config MR_CFG_RPC_CALL_BUCKET_NUM
    depends on MR_USE_MODULE_RPC
    int "RPC call hashmap bucket number"
    default 16
    range 1 1024
    help
        Number of buckets in the static RPC call hashmap. Increase this value
        when many calls are exported, or reduce it when RAM is tight.

# ==================================
# SESSION
# ==================================
config MR_CFG_MODULE_RPC_SESSION_NUM
    depends on MR_USE_MODULE_RPC
    int "RPC session number"
    default 1
    range 1 1024
    help
        Number of preallocated RPC sessions. Each session owns one fixed receive
        buffer and one fixed send buffer sized from generated IDL metadata.
        A new subscription requires one additional free session for ordinary
        requests. A single-session configuration does not accept subscriptions.

# ==================================
# FIFO
# ==================================
config MR_CFG_MODULE_RPC_FIFO_SIZE
    depends on MR_USE_MODULE_RPC
    int "RPC receive FIFO size"
    default 256
    range 24 1048576
    help
        Size in bytes of the RPC receive FIFO. At least 24 bytes are required
        to receive a frame header. Payloads and checksums are received separately.

endmenu
```

## include/mrX/modules/xbus/Kconfig
```kconfig
menu "XBus: Domain-scoped event bus"

# ==================================
# XBUS
# ==================================
config MR_USE_MODULE_XBUS
    depends on MR_USE_MODULE
    bool "Use XBus"
    default n
    help
        Enable the domain-scoped event bus module (XBus). Provides carrier-agnostic
        publish/subscribe messaging with domain namespaces, ACL isolation, wildcard
        matching, STATE/QUEUE pull semantics, and dentry-style inline/dynamic storage.

config MR_USE_MODULE_XBUS_MULTIUSER
    depends on MR_USE_MODULE_XBUS
    bool "Use XBus multi-user context"
    default n
    help
        Enable per-caller current domain resolution via the platform-supplied
        mr_xbus_domain_current() hook. When disabled, XBus provides a built-in
        current domain context defaulting to the host domain.

config MR_CFG_XBUS_DOMAIN_MAX
    depends on MR_USE_MODULE_XBUS
    int "XBus maximum domain count"
    default 32
    range 1 32
    help
        Maximum number of registered domains (IDs 0 to N-1, including the built-in
        host domain at ID 0).

config MR_CFG_XBUS_INLINE_NAME_LEN
    depends on MR_USE_MODULE_XBUS
    int "XBus inline name buffer length"
    default 16
    range 0 128
    help
        Inline short name buffer size in bytes for domain, topic, and subscription
        names (0 disables inline storage). Longer names spill transparently to
        dynamic allocation.

config MR_CFG_XBUS_INLINE_DATA_LEN
    depends on MR_USE_MODULE_XBUS
    int "XBus inline payload buffer length"
    default 16
    range 0 256
    help
        Inline small payload buffer size in bytes for topic state (0 disables
        inline storage). Larger payloads spill transparently to dynamic allocation.

config MR_CFG_XBUS_TOPIC_BUCKETS
    depends on MR_USE_MODULE_XBUS
    int "XBus topic hashmap bucket count"
    default 8
    range 4 256
    help
        Number of hash buckets used by the global XBus topic registry.

config MR_USE_MODULE_XBUS_TRACE
    depends on MR_USE_MODULE_XBUS && MR_USE_TRACE
    bool "Use XBus trace"
    default n
    help
        Emit kernel trace events for XBus publish, read, drop, stale, and domain
        reset operations.

endmenu
```

## include/mrX/modules/xtrace/Kconfig
```kconfig
menu "XTrace: System tracing and profiling"

# ==================================
# XTRACE
# ==================================
config MR_USE_MODULE_XTRACE
    depends on MR_USE_MODULE
    select MR_USE_TRACE
    bool "Use XTrace"
    default n
    help
        Enable the extensible tracing and profiling module (XTrace). Consumes
        generic kernel trace events through the trace port interface and
        provides pluggable protocol encoders and output adapters.

config MR_USE_MODULE_XTRACE_AUTO_START
    depends on MR_USE_MODULE_XTRACE
    bool "Use XTrace auto-start"
    default y
    help
        Automatically start trace recording during module initialization. Events
        emitted before an output adapter is registered are buffered in the
        internal FIFO.

config MR_CFG_XTRACE_BUF_SIZE
    depends on MR_USE_MODULE_XTRACE
    int "XTrace FIFO buffer size"
    default 4096
    range 256 65536
    help
        Size in bytes of the internal asynchronous trace FIFO buffer shared
        between protocol encoders and output adapters.

config MR_CFG_XTRACE_APP_NAME
    depends on MR_USE_MODULE_XTRACE
    string "XTrace application name"
    default "mrX"
    help
        Default application name reported in trace system metadata.

config MR_CFG_XTRACE_DEVICE_NAME
    depends on MR_USE_MODULE_XTRACE
    string "XTrace device name"
    default ""
    help
        Default device or target name reported in trace system metadata.

# ==================================
# RSOURCE
# ==================================
rsource 'proto/Kconfig'

endmenu
```
