## include/mrX/kernel/Kconfig
```kconfig
menu "Kernel: System services"

# ==================================
# ENTRY
# ==================================
config MR_USE_ENTRY
    bool "Use entry"
    default n
    help
        Enable entry point support. Provides standardized initialization and
        startup routines for the system.

# ==================================
# INITCALL
# ==================================
config MR_USE_INITCALL_TRACE
    depends on MR_USE_TRACE
    bool "Use initcall trace"
    default n
    help
        Enable trace events for user initcall execution during startup.

# ==================================
# REF
# ==================================
config MR_USE_REF_LONG_COUNT
    bool "Use ref long count"
    default y
    help
        Enable 16-bit reference counting instead of 8-bit. Use this when an
        object may have more than 255 concurrent references.

# ==================================
# CLOCK
# ==================================
config MR_CFG_CLOCK_HOOK_SIZE
    int "Clock hook size"
    default 2
    range 2 128
    help
        Maximum number of hook functions that can be registered to the clock
        subsystem. Hook functions are called on each tick.
        Increase if you need to register more clock callbacks.

config MR_CFG_TICK_PER_SECOND
    int "Tick per-second"
    default 1000
    range 1 2147483647
    help
        System tick frequency (Hz). Higher values provide better timing resolution
        but increase CPU overhead.
        Common values:
            - 100: Low overhead, 10ms resolution
            - 1000: Balanced, 1ms resolution (default)
            - 10000: High precision, 100us resolution

config MR_USE_CLOCK_HIRES
    bool "Use clock high resolution"
    default y
    help
        Enable high-resolution clock support. Provides up to microsecond timing
        precision for time-critical applications.
        This adds a secondary high-frequency tick source.

config MR_CFG_HIRES_TICK_PER_SECOND
    depends on MR_USE_CLOCK_HIRES
    int "High resolution tick per-second"
    default 1000000
    range MR_CFG_TICK_PER_SECOND 1000000
    help
        High-resolution tick frequency (Hz). This defines the precision of the
        high-resolution clock.
        Common value:
            - 1000000: Microsecond resolution (1us tick)

config MR_USE_CLOCK_TRACE
    depends on MR_USE_TRACE
    bool "Use clock trace"
    default n
    help
        Enable trace events for clock busy-wait spans and tickless idle
        duration sampling.

# ==================================
# PRINTF
# ==================================
config MR_USE_PRINTF
    bool "Use printf"
    default y
    help
        Enable lightweight printf implementation. Provides formatted output
        support without the full C library overhead.
        Disable to minimize code size if not needed.

config MR_CFG_PRINTF_BUF_SIZE
    depends on MR_USE_PRINTF
    int "Printf buffer size"
    default 64
    range 8 65535
    help
        Internal buffer size for printf formatting. Larger values support
        longer output strings but consume more RAM.
        Minimum recommended: 32 bytes
        Default: 64 bytes (supports most format strings)

config MR_USE_PRINTF_COLOR
    depends on MR_USE_PRINTF
    bool "Use printf color"
    default n
    help
        Enable ANSI color codes for printf output. Useful for terminal
        debugging and logging with color-coded severity levels.
        Requires terminal that supports ANSI escape codes.

config MR_USE_PRINTF_SAFE
    depends on MR_USE_PRINTF
    bool "Use printf safe"
    default n
    help
        Enable thread-safe printf by using heap-allocated buffers instead of static buffers.
        Static buffers are shared across all printf calls and can cause data races in
        multi-threaded environments. Dynamic allocation ensures each call has its own buffer.
        Trade-off: Thread safety and reduced stack usage at the cost of allocation overhead.

# ==================================
# LOG
# ==================================
config MR_USE_LOG
    select MR_USE_PRINTF
    bool "Use log"
    default y
    help
        Enable logging subsystem with configurable log levels and categories.
        Provides structured logging for debugging and monitoring.
        Automatically enables printf support.

config MR_CFG_LOG_LEVEL
    depends on MR_USE_LOG
    int "Log level"
    default 4
    range 0 4
    help
        Maximum log level to output. Messages above this level are filtered out.
        Levels:
            0 - NONE: Disable all logging
            1 - ERROR: Error conditions only
            2 - WARN: Warning and error messages
            3 - INFO: Informational messages (default)
            4 - DEBUG: Detailed debugging messages

config MR_CFG_LOG_TIME_ZONE
    depends on MR_USE_CLOCK_HIRES
    depends on MR_USE_LOG
    int "Log time zone"
    default 8
    range -12 12
    help
        Time zone offset from UTC in hours. Used for timestamp generation in log messages.
        Examples:
            0 - UTC (GMT)
            8 - UTC+8 (Beijing, Shanghai)
            -5 - UTC-5 (New York, EST)

# ==================================
# TIMER
# ==================================
config MR_USE_TIMER
    bool "Use timer"
    default y
    help
        Enable high-priority software timers that execute in tick interrupt context.
        Timer callbacks run at interrupt level with minimal latency.
        Suitable for time-critical operations but callbacks must be fast and non-blocking.

config MR_USE_TIMER_TRACE
    depends on MR_USE_TIMER
    depends on MR_USE_TRACE
    bool "Use timer trace"
    default n
    help
        Enable trace events for software timer start, stop, and timeout callback
        execution.

# ==================================
# WORK
# ==================================
config MR_USE_WORK
    select MR_USE_TIMER
    bool "Use work"
    default y
    help
        Enable low-priority deferred work execution in process context.
        Work items can sleep, block, and perform lengthy operations.
        Ideal for bottom-half processing from ISRs and concurrent task management.
        Provides higher concurrency and flexibility compared to interrupt-level timers.
        Automatically enables timer support for delayed work scheduling.

config MR_USE_WORKQUEUE_HOOK
    depends on MR_USE_WORK
    bool "Use workqueue hook"
    default n
    help
        Enable callbacks for workqueue lifecycle events.
        wakeup: Called when workqueue transitions from idle to running.
        suspend: Called when workqueue transitions from running to idle.
        Useful for custom scheduling, power management, or runtime monitoring.

config MR_USE_WORK_TRACE
    depends on MR_USE_WORK
    depends on MR_USE_TRACE
    bool "Use work trace"
    default n
    help
        Enable trace events for workqueue submission, cancellation, and work
        callback execution.

# ==================================
# IRQ
# ==================================
config MR_USE_IRQ
    bool "Use irq"
    default y
    help
        Enable interrupt management subsystem. Provides IRQ registration,
        priority handling, and interrupt context tracking.

config MR_CFG_IRQ_TABLE_SIZE
    depends on MR_USE_IRQ
    int "Irq table size"
    default 16
    range 2 1024
    help
        Maximum number of interrupt handlers that can be registered simultaneously.
        Each hardware IRQ vector consumes one entry in the table.
        Increase if your system uses many interrupt sources.

config MR_USE_IRQ_DEFER
    depends on MR_USE_IRQ
    select MR_USE_WORK
    bool "Use irq defer"
    default y
    help
        Enable deferred execution of IRQ handlers in process context via workqueue.
        Automatically enables workqueue support for deferred processing.

config MR_USE_IRQ_DEFER_HOOK
    depends on MR_USE_IRQ_DEFER
    select MR_USE_WORKQUEUE_HOOK
    bool "Use irq defer hook"
    default n
    help
        Enable lifecycle hooks for the IRQ defer workqueue.
        Inherits wakeup/suspend callbacks from workqueue hooks for monitoring
        when deferred IRQ handlers become active or idle.
        Useful for tracking interrupt processing activity and system observability.

config MR_USE_IRQ_TRACE
    depends on MR_USE_IRQ
    depends on MR_USE_TRACE
    bool "Use irq trace"
    default n
    help
        Enable trace events for interrupt handling, deferred execution, and
        enable/disable state changes.

# ==================================
# WAIT
# ==================================
config MR_USE_WAIT
    bool "Use wait"
    default y
    help
        Enable wait/synchronization primitives. Provides mechanisms for tasks
        to wait for events, conditions, or resources with timeout support.

config MR_USE_WAIT_TRACE
    depends on MR_USE_WAIT
    depends on MR_USE_TRACE
    bool "Use wait trace"
    default n
    help
        Enable trace events for waitable event raises, waiter notifications,
        registration, and cancellation.

# ==================================
# TRACE
# ==================================
config MR_USE_TRACE
    bool "Use trace"
    default n
    help
        Enable lightweight kernel tracing. Expands to zero overhead when
        disabled; when enabled, trace events are forwarded through the trace
        port interface.

config MR_CFG_TRACE_ARGS_MAX
    depends on MR_USE_TRACE
    int "Trace maximum arguments"
    default 8
    range 4 8
    help
        Maximum number of arguments accepted by a single trace event.

endmenu
```

## include/mrX/libc/Kconfig
```kconfig
menu "Libc: Standard library"

# ==================================
# ARCH
# ==================================
choice
    prompt "Arch"
    default MR_USE_ARCH_32B

    config MR_USE_ARCH_32B
        bool "32B"
        help
            Target 32-bit architecture. Pointers and size_t are 32 bits.
            Suitable for most MCUs (Cortex-M, etc.).

    config MR_USE_ARCH_64B
        bool "64B"
        help
            Target 64-bit architecture. Pointers and size_t are 64 bits.
            Suitable for application processors (Cortex-A, x86_64, etc.).
endchoice

# ==================================
# ASSERT
# ==================================
choice
    prompt "Assertion"
    default MR_USE_ASSERT

    config MR_USE_ASSERT_STD
        bool "STD"
        help
            Use standard library assert (assert.h). Aborts on failure.

    config MR_USE_ASSERT_3RD
        bool "3RD"
        help
            Use the assertion backend provided by the installed platform in
            <mrX/platform/libc/mr_assert.h>.

    config MR_USE_ASSERT
        bool "INT"
        help
            Use internal mrX assert implementation. Platform-specific panic handling.

    config MR_USE_ASSERT_NONE
        bool "NONE"
        help
            Disable all assertions. No runtime checks, smallest code size.
            Use only for production builds after thorough testing.
endchoice

# ==================================
# MALLOC
# ==================================
choice
    prompt "Malloc"
    default MR_USE_MALLOC

    config MR_USE_MALLOC_STD
        bool "STD"
        help
            Use standard library malloc/free. Requires host OS support.

    config MR_USE_MALLOC_3RD
        bool "3RD"
        help
            Use third-party memory allocator (e.g., tlsf, jemalloc).

    config MR_USE_MALLOC
        bool "INT"
        help
            Use internal mrX heap implementation. Lightweight, embedded-friendly.
            No fragmentation handling, suitable for constrained systems.
endchoice

config MR_CFG_HEAP_SIZE
    depends on !MR_USE_MALLOC_STD
    int "Heap memory size"
    default 4096
    range 32 2147483647
    help
        Size of heap memory pool in bytes when using internal malloc.
        Only applies to internal malloc implementation (not standard library).

# ==================================
# SPRINTF
# ==================================
choice
    prompt "Sprintf"
    default MR_USE_SPRINTF

    config MR_USE_SPRINTF_STD
        bool "STD"
        help
            Use standard library sprintf/snprintf.

    config MR_USE_SPRINTF_3RD
        bool "3RD"
        help
            Use third-party formatted output library.

    config MR_USE_SPRINTF
        bool "INT"
        help
            Use internal mrX sprintf implementation. Lightweight, reduced feature set.
            Supports basic format specifiers: %d, %u, %x, %s, %c, %p.
endchoice

# ==================================
# SSCANF
# ==================================
choice
    prompt "Sscanf"
    default MR_USE_SSCANF

    config MR_USE_SSCANF_STD
        bool "STD"
        help
            Use standard library sscanf.

    config MR_USE_SSCANF_3RD
        bool "3RD"
        help
            Use third-party formatted input library.

    config MR_USE_SSCANF
        bool "INT"
        help
            Use internal mrX sscanf implementation. Lightweight parser.
            Supports basic format specifiers: %d, %u, %x, %s, %c.
endchoice

# ==================================
# STRING
# ==================================
choice
    prompt "String"
    default MR_USE_STRING

    config MR_USE_STRING_STD
        bool "STD"
        help
            Use standard library string functions (string.h).

    config MR_USE_STRING_3RD
        bool "3RD"
        help
            Use third-party string library.

    config MR_USE_STRING
        bool "INT"
        help
            Use internal mrX string implementation. Optimized for embedded systems.
            Provides memcpy, memset, strcmp, strcpy, strlen, and bit operations.
endchoice

config MR_USE_STRING_SAFE
    depends on MR_USE_STRING
    bool "Use string null-ptr safety"
    default n
    help
        Enable NULL pointer checks in string functions (memcpy, memcmp, memset, etc.).
        Functions return NULL or 0 instead of crashing on NULL pointers.
        Adds small runtime overhead for safety in production environments.

# ==================================
# ATOMIC
# ==================================
choice
    prompt "Atomic"
    default MR_USE_ATOMIC

    config MR_USE_ATOMIC_3RD
        bool "3RD"
        help
            Use the atomic backend provided by the installed platform in
            <mrX/platform/libc/mr_atomic.h>. Windows uses native compiler atomics.

    config MR_USE_ATOMIC
        bool "INT"
        help
            Use internal mrX atomic implementation. Based on interrupt masking.
            Suitable for single-core systems without hardware atomic instructions.
endchoice

# ==================================
# TYPES
# ==================================
choice
    prompt "Types"
    default MR_USE_TYPES

    config MR_USE_TYPES_STD
        bool "STD"
        help
            Use standard C types (stdint.h, stddef.h, stdbool.h).

    config MR_USE_TYPES
        bool "INT"
        help
            Use internal mrX type definitions. Provides consistent naming
            (mr_int32_t, mr_size_t, etc.) across all platforms.
endchoice

# ==================================
# ERRNO
# ==================================
choice
    prompt "Errno"
    default MR_USE_ERRNO

    config MR_USE_ERRNO_STD
        bool "STD"
        help
            Use standard library errno (errno.h).

    config MR_USE_ERRNO_3RD
        bool "3RD"
        help
            Use third-party error code system.

    config MR_USE_ERRNO
        bool "INT"
        help
            Use internal mrX error codes. POSIX-compatible definitions.
            Provides MR_EPERM, MR_ENOENT, MR_EIO, MR_EAGAIN, MR_ENOMEM, etc.
endchoice

endmenu
```
