## include/mrX/modules/xtrace/proto/Kconfig
```kconfig
# ==================================
# PROTOCOL
# ==================================
choice
    prompt "XTrace protocol"
    depends on MR_USE_MODULE_XTRACE
    default MR_USE_MODULE_XTRACE_PROTO_CTF

    config MR_USE_MODULE_XTRACE_PROTO_NONE
        bool "None"
        help
            Do not enable a built-in protocol encoder. Register a custom
            protocol encoder via mr_xtrace_register().

    config MR_USE_MODULE_XTRACE_PROTO_CTF
        bool "CTF"
        help
            Enable the Common Trace Format (CTF) protocol encoder for XTrace.
            Encodes generic trace events into self-contained binary packets for
            host visualization and analysis.

    config MR_USE_MODULE_XTRACE_PROTO_SYSVIEW
        bool "SEGGER SystemView"
        help
            Enable the SEGGER SystemView protocol encoder for XTrace.
            Encodes generic trace events into SystemView binary packets
            compatible with SEGGER SystemView host tools.
endchoice

config MR_CFG_XTRACE_CTF_PACKET_SIZE
    depends on MR_USE_MODULE_XTRACE_PROTO_CTF
    int "XTrace CTF packet size"
    default 256
    range 256 4096
    help
        Maximum size in bytes of each CTF packet before committing to the
        registered output adapter.

config MR_CFG_SYSVIEW_MARKERS
    depends on MR_USE_MODULE_XTRACE_PROTO_SYSVIEW
    int "SystemView maximum markers"
    default 32
    range 8 256
    help
        Maximum number of distinct BEGIN/END marker names cached for SystemView
        marker ID mapping.
```

## include/mrX/modules/xvm/Kconfig
```kconfig
menu "XVM: Virtual machine"

# ==================================
# XVM
# ==================================
config MR_USE_MODULE_XVM
    depends on MR_USE_MODULE
    bool "Use XVM"
    default n
    help
        Enable the extensible virtual machine(XVM). Provides a small virtual
        machine with pluggable instruction-set architectures(ISA):
            - Load and execute binary images(flash) in separate data memory(RAM)
            - Register ISA implementations by name at runtime
            - Instruction-step scheduling with syscall and exception events
            - Pause/resume and status query

config MR_CFG_XVM_SYSCALL_PARAM_NUM
    depends on MR_USE_MODULE_XVM
    int "Syscall parameter number"
    default 7
    range 1 64
    help
        Number of parameter slots in the XVM syscall event. Each slot holds a
        pointer to a 64-bit syscall argument. Increase this value if an ISA
        needs to pass more arguments in a single syscall event.

# ==================================
# MMIO
# ==================================
config MR_USE_MODULE_XVM_MMIO
    depends on MR_USE_MODULE_XVM
    bool "Use XVM MMIO"
    default n
    help
        Enable the extensible MMIO region table for XVM. Host code can register
        custom memory-mapped peripheral callbacks on an XVM instance, and ISA
        backends forward unmatched MMIO accesses to the registered handlers.

config MR_CFG_XVM_MMIO_NUM
    depends on MR_USE_MODULE_XVM_MMIO
    int "MMIO region table size"
    default 8
    range 1 64
    help
        Maximum number of user MMIO regions that can be registered on an XVM.

# ==================================
# DEBUG
# ==================================
config MR_USE_MODULE_XVM_DEBUG
    depends on MR_USE_MODULE_XVM
    bool "Use XVM debug"
    default n
    help
        Enable the XVM debug breakpoint table. The ISA can call
        mr_xvm_break_hit() with the current program counter before fetch.
        Disable this option to omit the table from mr_xvm_t.

config MR_CFG_XVM_BREAKPOINT_NUM
    depends on MR_USE_MODULE_XVM_DEBUG
    int "Breakpoint table size"
    default 16
    range 1 64
    help
        Number of address-compare breakpoint slots in an XVM. An empty table
        keeps the existing execute fast path.

# ==================================
# GDB
# ==================================
config MR_USE_MODULE_XVM_GDB
    depends on MR_USE_MODULE_XVM_DEBUG
    bool "Use XVM GDB"
    default n
    help
        Enable the GDB Remote Serial Protocol adapter for XVM. The host
        supplies byte I/O; the adapter maps RSP packets onto XVM debug
        and execution interfaces.

config MR_CFG_XVM_GDB_PACKET_SIZE
    depends on MR_USE_MODULE_XVM_GDB
    int "GDB receive packet size"
    default 512
    range 272 8192
    help
        Receive buffer size, in bytes, for one GDB RSP packet payload. GDB
        advertises this as PacketSize. The floor is 272 because the first
        qSupported query from GDB is about 200 bytes, and the RV32 g/G
        all-register packets need 265 bytes. XML and memory transfers are
        sliced to this size. Prefer 512 unless RAM is tight.

config MR_CFG_XVM_GDB_REPLY_SIZE
    depends on MR_USE_MODULE_XVM_GDB
    int "GDB send reply size"
    default 512
    range 272 8192
    help
        Send buffer size, in bytes, for one GDB RSP reply, including packet
        framing. Target XML is generated in slices, so this buffer does not
        need to hold the full document. The floor is 272 because an RV32
        g-packet is 264 hex bytes plus four framing bytes. Prefer 512 unless
        RAM is tight.

# ==================================
# RSOURCE
# ==================================
rsource '*/*/Kconfig'

endmenu
```

## include/mrX/modules/xvm/isa/riscv32/Kconfig
```kconfig
menu "RISCV32: RISC-V 32-bit ISA"

# ==================================
# RISCV32
# ==================================
config MR_USE_MODULE_XVM_RISCV32
    depends on MR_USE_MODULE_XVM
    bool "Use RISC-V32"
    default n
    help
        Enable the RISC-V 32-bit ISA backend for XVM. This registers the
        "riscv32" ISA implementation and provides:
            - RV32 instruction decode and execution
            - Machine-mode CSR and trap handling
            - XVM syscall and exception delivery
            - MMIO-based external interrupt injection

config MR_USE_MODULE_XVM_RISCV32_C
    depends on MR_USE_MODULE_XVM_RISCV32
    bool "Use RISC-V32 C extension"
    default n
    help
        Enable the RV32C compressed instruction-set extension. Allows 16-bit
        compressed instructions mixed with 32-bit instructions on 2-byte
        aligned program counters and advertises the C extension in MISA.

config MR_USE_MODULE_XVM_RISCV32_LOOP_ACCEL
    depends on MR_USE_MODULE_XVM_RISCV32
    bool "Use RISC-V32 loop acceleration"
    default y
    help
        Enable backward-branch tight-loop acceleration in the RISC-V32
        interpreter. Recognizes common loop idioms (delay, fill, sum, copy)
        and caches a pre-decoded micro-op block (including inlined leaf calls)
        in core_t for general tight loops. Disable to minimize core_t RAM and
        code size.

config MR_CFG_XVM_RISCV32_LOOP_CACHE_SIZE
    depends on MR_USE_MODULE_XVM_RISCV32_LOOP_ACCEL
    int "Loop cache max instructions"
    default 32
    range 5 64
    help
        Maximum number of instructions (including the closing backward branch
        and any inlined leaf callee) in a pre-decoded tight-loop block. Each
        slot uses 9 bytes (8-byte micro-op plus 1-byte PC offset). Larger
        values accelerate longer loops and inlined calls at the cost of more
        RAM.

config MR_CFG_XVM_RISCV32_LOOP_MISS_SIZE
    depends on MR_USE_MODULE_XVM_RISCV32_LOOP_ACCEL
    int "Loop negative cache size"
    default 4
    range 1 16
    help
        Number of recently rejected backward-branch PCs remembered to avoid
        repeated pre-check and build attempts on non-accelerable loops such
        as outer loops or dynamic indirect-call loops.

config MR_USE_MODULE_XVM_RISCV32_LOOP_SHARED
    depends on MR_USE_MODULE_XVM_RISCV32_LOOP_ACCEL
    bool "Use shared decoded loop pool"
    default y
    help
        Store pre-decoded tight-loop blocks in a fixed-size shared Clock pool
        keyed by read-only binary image identity and branch PC instead of
        embedding a private loop cache in every core_t instance. Reduces
        per-instance RAM and accelerates multi-hotspot and multi-instance
        workloads.

config MR_CFG_XVM_RISCV32_LOOP_POOL_SIZE
    depends on MR_USE_MODULE_XVM_RISCV32_LOOP_SHARED
    int "Shared loop pool header count"
    default 32
    range 4 64
    help
        Number of fully-associative decoded-loop headers in the shared Clock
        pool. Each header tracks one cached loop block whose micro-ops live in
        the shared circular arena.

config MR_CFG_XVM_RISCV32_LOOP_ARENA_SIZE
    depends on MR_USE_MODULE_XVM_RISCV32_LOOP_SHARED
    int "Shared loop pool micro-op arena slots"
    default 256
    range 64 1024
    help
        Total number of variable-length micro-op slots in the shared circular
        arena. Each slot uses 9 bytes (8-byte micro-op plus 1-byte PC offset).
        Short loops only consume their actual instruction count, packing far
        more blocks into the same RAM budget than fixed-size slots.

config MR_CFG_XVM_RISCV32_LOOP_PRIVATE_SLOTS
    depends on MR_USE_MODULE_XVM_RISCV32_LOOP_ACCEL && !MR_USE_MODULE_XVM_RISCV32_LOOP_SHARED
    int "Private loop cache slots per instance"
    default 1
    range 1 2
    help
        Number of private decoded-loop cache slots embedded in each core_t
        instance when the shared pool is disabled. Use 1 for minimum RAM, or 2
        to avoid ping-pong rebuilds across two alternating hot loops.

endmenu
```

## include/mrX/test/Kconfig
```kconfig
menu "Test: Unit testing framework"

# ==================================
# TEST
# ==================================
config MR_USE_TEST
    select MR_USE_PRINTF
    bool "Use test"
    default n
    help
        Enable unit testing framework for automated verification.
        Features:
            - EXPECT macros: Continue on failure, log all errors
            - ASSERT macros: Stop immediately on failure
            - Comparison operations: EQ/NE/LT/LE/GT/GE/NEAR
            - Type support: int, uint, ptr, float, double
            - Test suite and testcase organization
            - Automatic test discovery and execution
            - Per-testcase pass/fail reporting
        Automatically enables printf for test result output.

endmenu
```

## include/mrX/vmc/Kconfig
```kconfig
menu "VMC options"

# ==================================
# VMC
# ==================================
config MR_USE_VMC
    bool "Use VMC"
    default n

# ==================================
# RSOURCE
# ==================================
rsource "*/Kconfig"

endmenu
```

## include/mrX/vmc/riscv32/Kconfig
```kconfig
menu "RISCV32 options"

# ==================================
# RISCV32
# ==================================
config MR_USE_VMC_RISCV32
    bool "Use RISCV32"
    default y

endmenu
```

## include/test/Kconfig
```kconfig
menu "Test options"

# ==================================
# TEST
# ==================================
config MR_USE_TEST
    bool "Use test"
    default n

endmenu
```

## source/base/Kconfig
```kconfig
menu "Base options"
    # DEBUG-RELEASE
    choice
        prompt "build type"
        default MR_USE_DEBUG
        help
            This option sets the build type.
        # DEBUG
        config MR_USE_DEBUG
            bool "debug"
            help
                This option sets the build type to debug.
        # RELEASE
        config MR_USE_RELEASE
            bool "release"
            help
                This option sets the build type to release.
    endchoice
    # LIBC
    config MR_USE_LIBC
        bool "use libc"
        default n
        help
            This option allows you to use the C runtime library.
    # HEAP
    comment "HEAP"
    config MR_CFG_HEAP_SIZE
    depends on !MR_USE_LIBC
        int "heap size (bytes)"
        default 16384
        range 16 2147483647
        help
            This option sets the size of the heap used by the library.
    # LOG
    comment "LOG"
    config MR_USE_LOG
    depends on MR_USE_DEBUG
        bool "use log"
        default y
    # LOG-LEVEL
    config MR_CFG_LOG_LEVEL
    depends on MR_USE_LOG
        int "log level"
        default 4
        range 0 4
        help
            This option sets the log level.
            0: None
            1: Error
            2: Warning
            3: Info
            4: Debug
endmenu
```
